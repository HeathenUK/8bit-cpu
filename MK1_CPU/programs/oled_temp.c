// SSD1306 OLED temperature display — fully data-driven, no overlays
// All I2C via i2c_stream. Glyphs built dynamically in page3 buffer.

// 0xFE=START, 0xFD=STOP, 0xFC N=REPEAT 0x00 N times,
// 0xFB=READ byte (result in C), 0xFF=END

// OLED init stream (offset 0)
unsigned char init_seq[] = {
    0xFE, 0x78, 0x00,
    0xAE, 0xA8, 0x3F, 0x8D, 0x14,
    0x20, 0x02, 0xA1, 0xC8,
    0xDA, 0x12, 0x81, 0xFF,
    0xA4, 0xA6, 0xAF,
    0xFD, 0xFF
};

// Clear stream (offset 21)
unsigned char clear_seq[] = {
    0xFE, 0x78, 0x00, 0xB0, 0x00, 0x10, 0xFD, 0xFE, 0x78, 0x40, 0xFC, 128, 0xFD,
    0xFE, 0x78, 0x00, 0xB1, 0x00, 0x10, 0xFD, 0xFE, 0x78, 0x40, 0xFC, 128, 0xFD,
    0xFE, 0x78, 0x00, 0xB2, 0x00, 0x10, 0xFD, 0xFE, 0x78, 0x40, 0xFC, 128, 0xFD,
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    0xFE, 0x78, 0x00, 0xB7, 0x00, 0x10, 0xFD, 0xFE, 0x78, 0x40, 0xFC, 128, 0xFD,
    0xFF
};

// Temp read stream (offset 126)
unsigned char temp_seq[] = {
    0xFE, 0xD0, 0x11, 0xFD,
    0xFE, 0xD1, 0xFB, 0xFD, 0xFF
};

// Font (65 bytes at offset 135)
unsigned char font[] = {
    0x3E, 0x51, 0x49, 0x45, 0x3E,
    0x00, 0x42, 0x7F, 0x40, 0x00,
    0x42, 0x61, 0x51, 0x49, 0x46,
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    0x3E, 0x41, 0x41, 0x41, 0x22
};

// Glyph display buffer at page3 offset 200
// Built dynamically: START 78 40 [5 bytes] 00 [5 bytes] 00 ... STOP END
unsigned char glyph_buf[30];

void send_glyph(unsigned char idx) {
    // Read 5 font bytes and send via I2C
    unsigned char base;
    unsigned char i;
    base = idx * 5 + 135;
    i2c_start();
    i2c_send_byte(0x78);
    i2c_send_byte(0x40);
    for (i = 0; i < 5; i++) {
        i2c_send_byte(peek3(base + i));
    }
    i2c_send_byte(0x00);
    i2c_stop();
}

void main() {
    unsigned char temp;
    unsigned char tens;
    unsigned char ones;

    i2c_init();
    i2c_bus_reset();
    i2c_stream(0);
    i2c_stream(21);

    i2c_stream(126);
    temp = i2c_stream_result();

    tens = 0;
    ones = temp;
    while (ones >= 10) {
        ones = ones - 10;
        tens = tens + 1;
    }

    // Set position: page 3, col 40
    i2c_start();
    i2c_send_byte(0x78);
    i2c_send_byte(0x00);
    i2c_send_byte(0xB3);
    i2c_send_byte(0x08);
    i2c_send_byte(0x12);
    i2c_stop();

    if (tens > 0) {
        send_glyph(tens);
    } else {
        send_glyph(10);
    }
    send_glyph(ones);
    send_glyph(11);
    send_glyph(12);

    out(temp);
    halt();
}
