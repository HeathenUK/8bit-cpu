// SSD1306 OLED temperature display — i2c_stream ONLY, no inline i2c_start/send.
// Demo: stock oled_temp.c doesn't fit (overlay_partition errors with
// `available=7B, wrapping=_show_temp=61B, _send_glyph=36B`). Adding `ee64`
// to one rarely-called function pushes its bytes off page-0 SRAM into the
// AT24C512 cold tier, freeing the overlay slot.

unsigned char init_seq[] = {
    0xFE, 0x78, 0x00,
    0xAE, 0xA8, 0x3F, 0x8D, 0x14,
    0x20, 0x02, 0xA1, 0xC8,
    0xDA, 0x12, 0x81, 0xFF,
    0xA4, 0xA6, 0xAF,
    0xFD, 0xFF
};

unsigned char clear_seq[] = {
    0xFE, 0x78, 0x00, 0xB0, 0x00, 0x10, 0xFD, 0xFE, 0x78, 0x40, 0xFC, 128, 0xFD,
    0xFE, 0x78, 0x00, 0xB1, 0x00, 0x10, 0xFD, 0xFE, 0x78, 0x40, 0xFC, 128, 0xFD,
    0xFE, 0x78, 0x00, 0xB2, 0x00, 0x10, 0xFD, 0xFE, 0x78, 0x40, 0xFC, 128, 0xFD,
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    0xFE, 0x78, 0x00, 0xB7, 0x00, 0x10, 0xFD, 0xFE, 0x78, 0x40, 0xFC, 128, 0xFD,
    0xFF
};

unsigned char temp_seq[] = {
    0xFE, 0xD0, 0x11, 0xFD,
    0xFE, 0xD1, 0xFB, 0xFD, 0xFF
};

unsigned char pos_seq[] = {
    0xFE, 0x78, 0x00, 0xB3, 0x08, 0x12, 0xFD, 0xFF
};

unsigned char font[] = {
    0x3E, 0x51, 0x49, 0x45, 0x3E,
    0x00, 0x42, 0x7F, 0x40, 0x00,
    0x42, 0x61, 0x51, 0x49, 0x46,
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    0x3E, 0x41, 0x41, 0x41, 0x22
};

unsigned char glyph_seq[] = {
    0xFE, 0x78, 0x40,
    0x00, 0x00, 0x00, 0x00, 0x00,
    0x00, 0xFD, 0xFF
};

ee64 void send_glyph(unsigned char idx) {
    unsigned char base;
    unsigned char i;
    base = idx * 5 + 143;
    i = 0;
    while (i < 5) {
        poke3(peek3(base + i), 208 + 3 + i);
        i = i + 1;
    }
    i2c_stream(208);
}

void show_temp(unsigned char temp) {
    unsigned char tens;
    unsigned char ones;
    tens = 0;
    ones = temp;
    while (ones >= 10) { ones = ones - 10; tens = tens + 1; }
    i2c_stream(135);   // position
    if (tens > 0) { send_glyph(tens); }
    else          { send_glyph(10); }
    send_glyph(ones);
    send_glyph(11);
    send_glyph(12);
}

void main() {
    unsigned char t;
    i2c_init();
    i2c_bus_reset();
    i2c_stream(0);      // OLED init
    i2c_stream(21);     // clear
    i2c_stream(126);    // temp read
    t = i2c_stream_result();
    show_temp(t);
    out(t);
    halt();
}
